## CMakeLists.txt
```
cmake_minimum_required(VERSION 3.20.0)
find_package(Zephyr REQUIRED HINTS $ENV{ZEPHYR_BASE})
project(zephyr_sensor_node)

target_include_directories(app PRIVATE include)

target_sources(app PRIVATE
    src/main.c
    src/app_state.c
    src/sensor_module.c
    src/command_module.c
)
```

## prj.conf
```kconfig
CONFIG_SERIAL=y
CONFIG_CONSOLE=y
CONFIG_UART_CONSOLE=y

CONFIG_LOG=y
CONFIG_LOG_DEFAULT_LEVEL=3
CONFIG_LOG_MODE_IMMEDIATE=y

CONFIG_MAIN_STACK_SIZE=2048
CONFIG_HEAP_MEM_POOL_SIZE=1024

CONFIG_THREAD_NAME=y
CONFIG_INIT_STACKS=y
CONFIG_ASSERT=y
CONFIG_REBOOT=y
```

## src/main.c
```c
#include <zephyr/kernel.h>
#include <zephyr/logging/log.h>
#include "app_state.h"
#include "sensor_module.h"
#include "command_module.h"

LOG_MODULE_REGISTER(app, LOG_LEVEL_INF);

int main(void)
{
    int ret = app_state_init();
    if (ret != 0) {
        LOG_ERR("Failed to initialize app state: %d", ret);
        return ret;
    }

    ret = sensor_module_init();
    if (ret != 0) {
        LOG_ERR("Failed to initialize sensor module: %d", ret);
        return ret;
    }

    ret = command_module_init();
    if (ret != 0) {
        LOG_ERR("Failed to initialize command module: %d", ret);
        return ret;
    }

    LOG_INF("zephyr-sensor-node booting on native_sim");
    LOG_INF("Day 5: timer-driven sensor pipeline active");

    struct k_msgq *sensor_q = sensor_module_get_msgq();

    while (1) {
        sensor_sample_t sample;
        ret = k_msgq_get(sensor_q, &sample, K_FOREVER);
        if (ret == 0) {
            app_state_inc_samples_processed();
            app_state_update_processing_seen(k_uptime_get());

            system_state_t state = app_state_get_copy();

            LOG_INF("Consumed sample seq=%u value=%d produced=%u processed=%u drops=%u fault_mode=%d",
                    sample.seq,
                    sample.value,
                    state.samples_produced,
                    state.samples_processed,
                    state.queue_drops,
                    state.fault_mode_enabled);
        }
    }

    return 0;
}
```

## include/app_state.h
```c
#ifndef APP_STATE_H
#define APP_STATE_H

#include <stdbool.h>
#include <stdint.h>
#include <zephyr/kernel.h>
#include "app_types.h"

int app_state_init(void);
system_state_t app_state_get_copy(void);

void app_state_set_latest_value(int32_t value);
void app_state_inc_samples_produced(void);
void app_state_inc_samples_processed(void);
void app_state_inc_queue_drops(void);
void app_state_inc_heartbeat(void);

void app_state_set_fault_mode(bool enabled, fault_type_t type);
void app_state_clear_faults(void);
void app_state_set_fault_active(bool active);

void app_state_update_sensor_seen(int64_t now_ms);
void app_state_update_processing_seen(int64_t now_ms);
void app_state_update_command_seen(int64_t now_ms);
void app_state_update_supervisor_seen(int64_t now_ms);

#endif
```

## include/app_types.h
```c
#ifndef APP_TYPES_H
#define APP_TYPES_H

#include <stdbool.h>
#include <stdint.h>

typedef enum {
    FAULT_NONE = 0,
    FAULT_RANGE,
    FAULT_STUCK,
    FAULT_TIMEOUT
} fault_type_t;

typedef struct {
    int32_t value;
    uint32_t seq;
    int64_t timestamp_ms;
    bool injected_fault;
} sensor_sample_t;

typedef struct {
    int32_t latest_value;
    uint32_t samples_produced;
    uint32_t samples_processed;
    uint32_t queue_drops;
    uint32_t heartbeat_count;
    bool fault_mode_enabled;
    bool fault_active;
    fault_type_t active_fault_type;
    int64_t sensor_last_seen_ms;
    int64_t processing_last_seen_ms;
    int64_t command_last_seen_ms;
    int64_t supervisor_last_seen_ms;
} system_state_t;

#endif
```

## include/command_module.h
```c
#ifndef COMMAND_MODULE_H
#define COMMAND_MODULE_H

int command_module_init(void);

#endif
```

## include/sensor_module.h
```c
#ifndef SENSOR_MODULE_H
#define SENSOR_MODULE_H

#include <zephyr/kernel.h>
#include "app_types.h"

#define SENSOR_QUEUE_MAX_ITEMS 8

int sensor_module_init(void);
struct k_msgq *sensor_module_get_msgq(void);

#endif
```

## src/app_state.c
```c
#include <string.h>
#include <zephyr/kernel.h>
#include "app_state.h"

static system_state_t g_state;
static struct k_mutex g_state_mutex;

static void app_state_lock(void)
{
    k_mutex_lock(&g_state_mutex, K_FOREVER);
}

static void app_state_unlock(void)
{
    k_mutex_unlock(&g_state_mutex);
}

int app_state_init(void)
{
    int ret = k_mutex_init(&g_state_mutex);
    if (ret != 0) {
        return ret;
    }

    memset(&g_state, 0, sizeof(g_state));
    g_state.active_fault_type = FAULT_NONE;

    int64_t now_ms = k_uptime_get();
    g_state.sensor_last_seen_ms = now_ms;
    g_state.processing_last_seen_ms = now_ms;
    g_state.command_last_seen_ms = now_ms;
    g_state.supervisor_last_seen_ms = now_ms;

    return 0;
}

system_state_t app_state_get_copy(void)
{
    system_state_t copy;

    app_state_lock();
    copy = g_state;
    app_state_unlock();

    return copy;
}

void app_state_set_latest_value(int32_t value)
{
    app_state_lock();
    g_state.latest_value = value;
    app_state_unlock();
}

void app_state_inc_samples_produced(void)
{
    app_state_lock();
    g_state.samples_produced++;
    app_state_unlock();
}

void app_state_inc_samples_processed(void)
{
    app_state_lock();
    g_state.samples_processed++;
    app_state_unlock();
}

void app_state_inc_queue_drops(void)
{
    app_state_lock();
    g_state.queue_drops++;
    app_state_unlock();
}

void app_state_inc_heartbeat(void)
{
    app_state_lock();
    g_state.heartbeat_count++;
    app_state_unlock();
}

void app_state_set_fault_mode(bool enabled, fault_type_t type)
{
    app_state_lock();
    g_state.fault_mode_enabled = enabled;
    g_state.active_fault_type = enabled ? type : FAULT_NONE;
    app_state_unlock();
}

void app_state_clear_faults(void)
{
    app_state_lock();
    g_state.fault_mode_enabled = false;
    g_state.fault_active = false;
    g_state.active_fault_type = FAULT_NONE;
    app_state_unlock();
}

void app_state_set_fault_active(bool active)
{
    app_state_lock();
    g_state.fault_active = active;
    app_state_unlock();
}

void app_state_update_sensor_seen(int64_t now_ms)
{
    app_state_lock();
    g_state.sensor_last_seen_ms = now_ms;
    app_state_unlock();
}

void app_state_update_processing_seen(int64_t now_ms)
{
    app_state_lock();
    g_state.processing_last_seen_ms = now_ms;
    app_state_unlock();
}

void app_state_update_command_seen(int64_t now_ms)
{
    app_state_lock();
    g_state.command_last_seen_ms = now_ms;
    app_state_unlock();
}

void app_state_update_supervisor_seen(int64_t now_ms)
{
    app_state_lock();
    g_state.supervisor_last_seen_ms = now_ms;
    app_state_unlock();
}
```

## src/command_module.c
```c
#include <string.h>
#include <zephyr/kernel.h>
#include <zephyr/device.h>
#include <zephyr/drivers/uart.h>
#include <zephyr/logging/log.h>
#include <zephyr/devicetree.h>
#include "command_module.h"
#include "app_state.h"

LOG_MODULE_REGISTER(command_module, LOG_LEVEL_INF);

#define CMD_THREAD_STACK_SIZE 1536
#define CMD_THREAD_PRIORITY 6
#define CMD_BUF_SIZE 64

static struct k_thread cmd_thread_data;
K_THREAD_STACK_DEFINE(cmd_thread_stack, CMD_THREAD_STACK_SIZE);

static const struct device *console_dev = DEVICE_DT_GET(DT_CHOSEN(zephyr_console));

static void print_help(void)
{
    LOG_INF("Commands: help | status | fault on | fault off");
}

static void handle_command(const char *cmd)
{
    if (strcmp(cmd, "help") == 0) {
        print_help();
    } else if (strcmp(cmd, "status") == 0) {
        system_state_t state = app_state_get_copy();
        LOG_INF("STATUS latest=%d produced=%u processed=%u drops=%u hb=%u fault_mode=%d fault_active=%d",
                state.latest_value,
                state.samples_produced,
                state.samples_processed,
                state.queue_drops,
                state.heartbeat_count,
                state.fault_mode_enabled,
                state.fault_active);
    } else if (strcmp(cmd, "fault on") == 0) {
        app_state_set_fault_mode(true, FAULT_RANGE);
        app_state_set_fault_active(true);
        LOG_WRN("Fault mode enabled");
    } else if (strcmp(cmd, "fault off") == 0) {
        app_state_clear_faults();
        LOG_INF("Fault mode disabled");
    } else if (strlen(cmd) > 0) {
        LOG_WRN("Unknown command: %s", cmd);
        print_help();
    }
}

static void command_thread_entry(void *p1, void *p2, void *p3)
{
    ARG_UNUSED(p1);
    ARG_UNUSED(p2);
    ARG_UNUSED(p3);

    if (!device_is_ready(console_dev)) {
        LOG_ERR("Console UART device not ready");
        return;
    }

    char buf[CMD_BUF_SIZE];
    size_t idx = 0;

    LOG_INF("Command thread ready; type 'help'");

    while (1) {
        unsigned char c;
        int ret = uart_poll_in(console_dev, &c);

        if (ret == 0) {
            app_state_update_command_seen(k_uptime_get());

            if (c == '\r' || c == '\n') {
                buf[idx] = '\0';
                handle_command(buf);
                idx = 0;
                memset(buf, 0, sizeof(buf));
            } else if (idx < (CMD_BUF_SIZE - 1)) {
                buf[idx++] = (char)c;
            } else {
                LOG_WRN("Command too long, clearing buffer");
                idx = 0;
                memset(buf, 0, sizeof(buf));
            }
        } else {
            k_msleep(20);
        }
    }
}

int command_module_init(void)
{
    k_tid_t tid = k_thread_create(&cmd_thread_data,
                                  cmd_thread_stack,
                                  K_THREAD_STACK_SIZEOF(cmd_thread_stack),
                                  command_thread_entry,
                                  NULL, NULL, NULL,
                                  CMD_THREAD_PRIORITY,
                                  0,
                                  K_NO_WAIT);

    if (tid == NULL) {
        return -1;
    }

    k_thread_name_set(tid, "command_thread");
    return 0;
}
```

## src/sensor_module.c
```c
#include <zephyr/kernel.h>
#include <zephyr/logging/log.h>
#include "sensor_module.h"
#include "app_state.h"

LOG_MODULE_REGISTER(sensor_module, LOG_LEVEL_INF);

#define SENSOR_THREAD_PRIORITY 5
#define SENSOR_PERIOD_MS 1000
#define SENSOR_QUEUE_MAX_ITEMS 8

K_MSGQ_DEFINE(sensor_msgq, sizeof(sensor_sample_t), SENSOR_QUEUE_MAX_ITEMS, 4);

/* Timer + delayable work for periodic sampling */
static struct k_timer sensor_timer;
static struct k_work_delayable sensor_work;

static uint32_t sample_seq;

static void sensor_work_handler(struct k_work *work)
{
    ARG_UNUSED(work);

    static int32_t normal_value = 20;

    system_state_t state = app_state_get_copy();

    int32_t value = state.fault_mode_enabled ? 999 : normal_value;

    sensor_sample_t sample = {
        .value = value,
        .seq = sample_seq,
        .timestamp_ms = k_uptime_get(),
        .injected_fault = state.fault_mode_enabled,
    };

    int ret = k_msgq_put(&sensor_msgq, &sample, K_NO_WAIT);
    if (ret == 0) {
        app_state_set_latest_value(sample.value);
        app_state_inc_samples_produced();
        app_state_update_sensor_seen(sample.timestamp_ms);
        LOG_INF("Produced sample seq=%u value=%d fault=%d",
                sample.seq, sample.value, sample.injected_fault);
    } else {
        app_state_inc_queue_drops();
        LOG_WRN("Sensor queue full, dropped seq=%u", sample.seq);
    }

    /* Advance state for next sample */
    sample_seq++;
    if (!state.fault_mode_enabled) {
        normal_value++;
        if (normal_value > 30) {
            normal_value = 20;
        }
    }

    /* Reschedule work for next period */
    k_work_schedule(&sensor_work, K_MSEC(SENSOR_PERIOD_MS));
}

static void sensor_timer_handler(struct k_timer *timer)
{
    ARG_UNUSED(timer);

    /* Just submit work to run in thread context */
    k_work_schedule(&sensor_work, K_NO_WAIT);
}

int sensor_module_init(void)
{
    sample_seq = 0;

    /* Initialize delayable work */
    k_work_init_delayable(&sensor_work, sensor_work_handler);

    /* Initialize and start periodic timer */
    k_timer_init(&sensor_timer, sensor_timer_handler, NULL);
    k_timer_start(&sensor_timer, K_MSEC(SENSOR_PERIOD_MS), K_MSEC(SENSOR_PERIOD_MS));

    return 0;
}

struct k_msgq *sensor_module_get_msgq(void)
{
    return &sensor_msgq;
}
```
