## CMakeLists.txt
```
cmake_minimum_required(VERSION 3.20.0)

find_package(Zephyr REQUIRED HINTS $ENV{ZEPHYR_BASE})
project(zephyr_sensor_node)

target_include_directories(app PRIVATE
    ${CMAKE_CURRENT_SOURCE_DIR}/include
)

target_sources(app PRIVATE
    src/main.c
    src/app_state.c
    src/sensor_module.c
    src/sensor_logic.c
    src/command_module.c
)
```

## prj.conf
```kconfig
CONFIG_SERIAL=y
CONFIG_CONSOLE=y
CONFIG_UART_CONSOLE=y

CONFIG_SHELL=y
CONFIG_SHELL_BACKEND_SERIAL=y
CONFIG_SHELL_PROMPT_UART="sensor-node:~$ "
CONFIG_SHELL_CMD_BUFF_SIZE=256
CONFIG_SHELL_PRINTF_BUFF_SIZE=30
CONFIG_SHELL_HISTORY=y
CONFIG_SHELL_HISTORY_BUFFER=512

CONFIG_LOG=y
CONFIG_LOG_DEFAULT_LEVEL=3
CONFIG_LOG_MODE_IMMEDIATE=y

CONFIG_MAIN_STACK_SIZE=2048
CONFIG_HEAP_MEM_POOL_SIZE=1024

CONFIG_THREAD_NAME=y
CONFIG_INIT_STACKS=y
CONFIG_ASSERT=y
CONFIG_REBOOT=y
```

## src/main.c
```c
#include <zephyr/kernel.h>
#include <zephyr/logging/log.h>
#include "app_state.h"
#include "sensor_module.h"
#include "command_module.h"

LOG_MODULE_REGISTER(app, LOG_LEVEL_INF);

int main(void)
{
    int ret = app_state_init();
    if (ret != 0) {
        LOG_ERR("Failed to initialize app state: %d", ret);
        return ret;
    }

    ret = sensor_module_init();
    if (ret != 0) {
        LOG_ERR("Failed to initialize sensor module: %d", ret);
        return ret;
    }

    ret = command_module_init();
    if (ret != 0) {
        LOG_ERR("Failed to initialize command module: %d", ret);
        return ret;
    }

    LOG_INF("zephyr-sensor-node booting on native_sim");
    LOG_INF("Shell-based command interface active");

    struct k_msgq *sensor_q = sensor_module_get_msgq();

    while (1) {
        sensor_sample_t sample;
        ret = k_msgq_get(sensor_q, &sample, K_FOREVER);
        if (ret == 0) {
            app_state_inc_samples_processed();
            app_state_update_processing_seen(k_uptime_get());

            system_state_t state = app_state_get_copy();

            LOG_INF("Consumed sample seq=%u value=%d produced=%u processed=%u drops=%u fault_mode=%d",
                    sample.seq,
                    sample.value,
                    state.samples_produced,
                    state.samples_processed,
                    state.queue_drops,
                    state.fault_mode_enabled);
        }
    }

    return 0;
}
```

## include/app_state.h
```c
#ifndef APP_STATE_H
#define APP_STATE_H

#include <zephyr/kernel.h>
#include "app_types.h"

int app_state_init(void);
system_state_t app_state_get_copy(void);

void app_state_set_latest_value(int32_t value);
void app_state_inc_samples_produced(void);
void app_state_inc_samples_processed(void);
void app_state_inc_queue_drops(void);
void app_state_inc_heartbeat(void);

void app_state_set_fault_mode(bool enabled, fault_type_t type);
void app_state_set_fault_active(bool active);
void app_state_clear_faults(void);

void app_state_update_sensor_seen(int64_t now_ms);
void app_state_update_processing_seen(int64_t now_ms);
void app_state_update_command_seen(int64_t now_ms);

#endif
```

## include/app_types.h
```c
#ifndef APP_TYPES_H
#define APP_TYPES_H

#include <stdint.h>
#include <stdbool.h>

typedef enum {
    FAULT_NONE,
    FAULT_RANGE,
    FAULT_STUCK,
    FAULT_NOISY,
} fault_type_t;

typedef struct {
    int32_t value;
    uint32_t seq;
    int64_t timestamp_ms;
    bool injected_fault;
} sensor_sample_t;

typedef struct {
    int32_t latest_value;
    uint32_t samples_produced;
    uint32_t samples_processed;
    uint32_t queue_drops;
    uint32_t heartbeat_count;

    bool fault_mode_enabled;
    bool fault_active;
    fault_type_t fault_type;
    uint32_t fault_start_time_ms;
    uint32_t fault_duration_ms;

    int64_t last_sensor_seen_ms;
    int64_t last_processing_seen_ms;
    int64_t last_command_seen_ms;
} system_state_t;

#endif
```

## include/command_module.h
```c
#ifndef COMMAND_MODULE_H
#define COMMAND_MODULE_H

int command_module_init(void);

#endif
```

## include/sensor_logic.h
```c
#ifndef SENSOR_LOGIC_H
#define SENSOR_LOGIC_H

#include <stdint.h>
#include "app_types.h"

#define SENSOR_NORMAL_MIN 20
#define SENSOR_NORMAL_MAX 30
#define SENSOR_FAULT_RANGE_VALUE 999

int32_t sensor_logic_generate(fault_type_t type, uint32_t seq, int32_t *normal_value);

#endif
```

## include/sensor_module.h
```c
#ifndef SENSOR_MODULE_H
#define SENSOR_MODULE_H

#include <zephyr/kernel.h>
#include "app_types.h"

#define SENSOR_QUEUE_MAX_ITEMS 8

int sensor_module_init(void);
struct k_msgq *sensor_module_get_msgq(void);
struct k_sem *sensor_module_get_sample_sem(void);

#endif
```

## src/app_state.c
```c
#include <zephyr/kernel.h>
#include <zephyr/logging/log.h>
#include "app_state.h"

LOG_MODULE_REGISTER(app_state, LOG_LEVEL_INF);

static struct k_mutex state_lock;
static system_state_t app_state;

int app_state_init(void)
{
    k_mutex_init(&state_lock);

    k_mutex_lock(&state_lock, K_FOREVER);
    memset(&app_state, 0, sizeof(app_state));
    app_state.fault_type = FAULT_NONE;
    k_mutex_unlock(&state_lock);

    return 0;
}

system_state_t app_state_get_copy(void)
{
    system_state_t copy;

    k_mutex_lock(&state_lock, K_FOREVER);
    copy = app_state;
    k_mutex_unlock(&state_lock);

    return copy;
}

void app_state_set_latest_value(int32_t value)
{
    k_mutex_lock(&state_lock, K_FOREVER);
    app_state.latest_value = value;
    k_mutex_unlock(&state_lock);
}

void app_state_inc_samples_produced(void)
{
    k_mutex_lock(&state_lock, K_FOREVER);
    app_state.samples_produced++;
    k_mutex_unlock(&state_lock);
}

void app_state_inc_samples_processed(void)
{
    k_mutex_lock(&state_lock, K_FOREVER);
    app_state.samples_processed++;
    k_mutex_unlock(&state_lock);
}

void app_state_inc_queue_drops(void)
{
    k_mutex_lock(&state_lock, K_FOREVER);
    app_state.queue_drops++;
    k_mutex_unlock(&state_lock);
}

void app_state_inc_heartbeat(void)
{
    k_mutex_lock(&state_lock, K_FOREVER);
    app_state.heartbeat_count++;
    k_mutex_unlock(&state_lock);
}

void app_state_set_fault_mode(bool enabled, fault_type_t type)
{
    k_mutex_lock(&state_lock, K_FOREVER);

    if (enabled) {
        app_state.fault_mode_enabled = true;
        app_state.fault_type = type;
        app_state.fault_start_time_ms = k_uptime_get_32();
    } else {
        app_state.fault_mode_enabled = false;
        app_state.fault_type = FAULT_NONE;
        app_state.fault_start_time_ms = 0;
    }

    k_mutex_unlock(&state_lock);
}

void app_state_set_fault_active(bool active)
{
    k_mutex_lock(&state_lock, K_FOREVER);
    app_state.fault_active = active;
    k_mutex_unlock(&state_lock);
}

void app_state_clear_faults(void)
{
    k_mutex_lock(&state_lock, K_FOREVER);
    app_state.fault_mode_enabled = false;
    app_state.fault_active = false;
    app_state.fault_type = FAULT_NONE;
    app_state.fault_start_time_ms = 0;
    k_mutex_unlock(&state_lock);
}

void app_state_update_sensor_seen(int64_t now_ms)
{
    k_mutex_lock(&state_lock, K_FOREVER);
    app_state.last_sensor_seen_ms = now_ms;
    k_mutex_unlock(&state_lock);
}

void app_state_update_processing_seen(int64_t now_ms)
{
    k_mutex_lock(&state_lock, K_FOREVER);
    app_state.last_processing_seen_ms = now_ms;
    k_mutex_unlock(&state_lock);
}

void app_state_update_command_seen(int64_t now_ms)
{
    k_mutex_lock(&state_lock, K_FOREVER);
    app_state.last_command_seen_ms = now_ms;
    k_mutex_unlock(&state_lock);
}
```

## src/command_module.c
```c
#include <string.h>
#include <zephyr/kernel.h>
#include <zephyr/logging/log.h>
#include <zephyr/shell/shell.h>

#include "command_module.h"
#include "app_state.h"

LOG_MODULE_REGISTER(command_module, LOG_LEVEL_INF);

static const char *fault_type_name(fault_type_t type)
{
    switch (type) {
    case FAULT_RANGE:
        return "range";
    case FAULT_STUCK:
        return "stuck";
    case FAULT_NOISY:
        return "noisy";
    case FAULT_NONE:
    default:
        return "none";
    }
}

static int cmd_status(const struct shell *sh, size_t argc, char **argv)
{
    ARG_UNUSED(argc);
    ARG_UNUSED(argv);

    system_state_t state = app_state_get_copy();
    bool queue_healthy = (state.queue_drops == 0);

    shell_print(sh, "STATUS");
    shell_print(sh, "  latest_value: %d", state.latest_value);
    shell_print(sh, "  fault_mode: %s",
                state.fault_mode_enabled ? "enabled" : "disabled");
    shell_print(sh, "  fault_type: %s", fault_type_name(state.fault_type));
    shell_print(sh, "  fault_active: %s",
                state.fault_active ? "yes" : "no");
    shell_print(sh, "  last_sensor_seen_ms: %lld",
                (long long)state.last_sensor_seen_ms);
    shell_print(sh, "  last_processing_seen_ms: %lld",
                (long long)state.last_processing_seen_ms);
    shell_print(sh, "  queue_health: %s",
                queue_healthy ? "healthy" : "drops detected");

    return 0;
}

static int cmd_stats(const struct shell *sh, size_t argc, char **argv)
{
    ARG_UNUSED(argc);
    ARG_UNUSED(argv);

    system_state_t state = app_state_get_copy();
    uint32_t fault_duration_ms = 0;

    if (state.fault_mode_enabled) {
        fault_duration_ms = k_uptime_get_32() - state.fault_start_time_ms;
    }

    shell_print(sh, "STATS");
    shell_print(sh, "  samples_produced: %u", state.samples_produced);
    shell_print(sh, "  samples_processed: %u", state.samples_processed);
    shell_print(sh, "  queue_drops: %u", state.queue_drops);
    shell_print(sh, "  heartbeat_count: %u", state.heartbeat_count);
    shell_print(sh, "  fault_duration_ms: %u", fault_duration_ms);

    return 0;
}

static int cmd_fault_range(const struct shell *sh, size_t argc, char **argv)
{
    ARG_UNUSED(argc);
    ARG_UNUSED(argv);

    app_state_set_fault_mode(true, FAULT_RANGE);
    app_state_set_fault_active(true);

    shell_print(sh, "Fault mode enabled: range");

    return 0;
}

static int cmd_fault_stuck(const struct shell *sh, size_t argc, char **argv)
{
    ARG_UNUSED(argc);
    ARG_UNUSED(argv);

    app_state_set_fault_mode(true, FAULT_STUCK);
    app_state_set_fault_active(true);

    shell_print(sh, "Fault mode enabled: stuck");

    return 0;
}

static int cmd_fault_noisy(const struct shell *sh, size_t argc, char **argv)
{
    ARG_UNUSED(argc);
    ARG_UNUSED(argv);

    app_state_set_fault_mode(true, FAULT_NOISY);
    app_state_set_fault_active(true);

    shell_print(sh, "Fault mode enabled: noisy");

    return 0;
}

static int cmd_fault_off(const struct shell *sh, size_t argc, char **argv)
{
    ARG_UNUSED(argc);
    ARG_UNUSED(argv);

    app_state_clear_faults();

    shell_print(sh, "Fault mode disabled");

    return 0;
}

SHELL_STATIC_SUBCMD_SET_CREATE(app_cmds,
    SHELL_CMD(status, NULL, "Show current system health and state", cmd_status),
    SHELL_CMD(stats, NULL, "Show cumulative runtime counters", cmd_stats),
    SHELL_CMD(fault_range, NULL, "Enable range fault", cmd_fault_range),
    SHELL_CMD(fault_stuck, NULL, "Enable stuck fault", cmd_fault_stuck),
    SHELL_CMD(fault_noisy, NULL, "Enable noisy fault", cmd_fault_noisy),
    SHELL_CMD(fault_off, NULL, "Disable fault mode", cmd_fault_off),
    SHELL_SUBCMD_SET_END
);

SHELL_CMD_REGISTER(app, &app_cmds, "Application commands", NULL);

int command_module_init(void)
{
    return 0;
}
```

## src/sensor_logic.c
```c
#include "sensor_logic.h"

int32_t sensor_logic_generate(fault_type_t type, uint32_t seq, int32_t *normal_value)
{
    switch (type) {
    case FAULT_RANGE:
        return SENSOR_FAULT_RANGE_VALUE;

    case FAULT_STUCK:
        return *normal_value;

    case FAULT_NOISY:
        return *normal_value + (int32_t)(seq % 5);

    case FAULT_NONE:
    default:
        break;
    }

    int32_t value = *normal_value;

    (*normal_value)++;
    if (*normal_value > SENSOR_NORMAL_MAX) {
        *normal_value = SENSOR_NORMAL_MIN;
    }

    return value;
}
```

## src/sensor_module.c
```c
#include <zephyr/kernel.h>
#include <zephyr/logging/log.h>

#include "sensor_module.h"
#include "sensor_logic.h"
#include "app_state.h"

LOG_MODULE_REGISTER(sensor_module, LOG_LEVEL_INF);

#define SENSOR_PERIOD_MS 1000
#define SENSOR_QUEUE_MAX_ITEMS 8

K_MSGQ_DEFINE(sensor_msgq, sizeof(sensor_sample_t), SENSOR_QUEUE_MAX_ITEMS, 4);

static struct k_timer sensor_timer;
static struct k_work_delayable sensor_work;

static uint32_t sample_seq;
static int32_t normal_value = SENSOR_NORMAL_MIN;

static void sensor_work_handler(struct k_work *work)
{
    ARG_UNUSED(work);

    system_state_t state = app_state_get_copy();

    int32_t value = sensor_logic_generate(state.fault_type, sample_seq, &normal_value);

    sensor_sample_t sample = {
        .value = value,
        .seq = sample_seq,
        .timestamp_ms = k_uptime_get(),
        .injected_fault = state.fault_mode_enabled,
    };

    int ret = k_msgq_put(&sensor_msgq, &sample, K_NO_WAIT);

    if (ret == 0) {
        app_state_set_latest_value(sample.value);
        app_state_inc_samples_produced();
        app_state_update_sensor_seen(sample.timestamp_ms);

        if (state.fault_mode_enabled) {
            uint32_t duration = k_uptime_get_32() - state.fault_start_time_ms;

            LOG_WRN("Fault sample seq=%u type=%d value=%d duration=%u ms",
                    sample.seq, state.fault_type, sample.value, duration);
        } else {
            LOG_INF("Produced sample seq=%u value=%d fault=0",
                    sample.seq, sample.value);
        }
    } else {
        app_state_inc_queue_drops();
        LOG_WRN("Sensor queue full, dropped seq=%u", sample.seq);
    }

    sample_seq++;
    k_work_schedule(&sensor_work, K_MSEC(SENSOR_PERIOD_MS));
}

static void sensor_timer_handler(struct k_timer *timer)
{
    ARG_UNUSED(timer);
    k_work_schedule(&sensor_work, K_NO_WAIT);
}

int sensor_module_init(void)
{
    sample_seq = 0;
    normal_value = SENSOR_NORMAL_MIN;

    k_work_init_delayable(&sensor_work, sensor_work_handler);

    k_timer_init(&sensor_timer, sensor_timer_handler, NULL);
    k_timer_start(&sensor_timer, K_MSEC(SENSOR_PERIOD_MS), K_MSEC(SENSOR_PERIOD_MS));

    return 0;
}

struct k_msgq *sensor_module_get_msgq(void)
{
    return &sensor_msgq;
}
```
